## boards/Kconfig.board
```kconfig
config BOARD_PROMICRO_NRF52840_ZMK
    bool "Pro Micro nRF52840 ZMK (with pro_micro_i2c)"
    depends on SOC_NRF52840_QIAA
```

## boards/Kconfig.defconfig
```kconfig
if BOARD_PROMICRO_NRF52840_ZMK
config BOARD
    default "promicro_nrf52840_zmk"
endif
```
